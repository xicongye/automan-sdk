## arch/Kconfig
```kconfig
choice
	prompt "Architecture select"
	default ARCH_RISCV64

config ARCH_RISCV64
	bool "RISCV64"

config ARCH_RISCV32
	bool "RISCV32"
endchoice


source "arch/riscv64/Kconfig"
source "arch/riscv32/Kconfig"
```

## driver/interrupt/Kconfig
```kconfig
menu "IRQ chip support"

config PLIC
    bool "PLIC IRQ CONTROLLER"
    default y
    depends on ARCH_RISCV64

endmenu
```
